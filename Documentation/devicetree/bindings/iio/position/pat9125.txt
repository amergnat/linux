## Documentation/devicetree/bindings/iio/position/pat9125.txt
```
PixArt Imaging PAT9125 Optical Tracking Miniature Chip device driver

Required properties:
	- compatible: must be "pixart,pat9125"
	- reg: i2c address where to find the device
	- interrupts: the sole interrupt generated by the device

	Refer to interrupt-controller/interrupts.txt for generic
	interrupt client node bindings.

Example:

pat9125@75 {
	compatible = "pixart,pat9125";
	reg = <0x75>;
	interrupt-parent = <&gpio3>;
	interrupts = <12 IRQ_TYPE_EDGE_FALLING>;
};
```

## Documentation/devicetree/bindings/iio/position/pixart,pat9125.yaml
```yaml
# SPDX-License-Identifier: GPL-2.0
%YAML 1.2
---
$id: http://devicetree.org/schemas/iio/accel/pixart,pat9125.yaml#
$schema: http://devicetree.org/meta-schemas/core.yaml#

title: PixArt Imaging PAT9125 Optical Tracking Miniature Chip

maintainers:
  - Alexandre Mergnat <amergnat@baylibre.com>

description: |
  PixArt Imaging PAT9125 Optical Tracking Miniature Chip device driver that
  supports I2C interfaces
    http://www.pixart.com/products-detail/72/PAT9125EL-TKIT___TKMT

properties:
  compatible:
    enum:
      - pixart,pat9125

  reg:
    maxItems: 1

  interrupts:
    maxItems: 1

required:
  - compatible
  - reg
  - interrupts

examples:
  - |
        pat9125@75 {
        	compatible = "pixart,pat9125";
        	reg = <0x75>;
        	interrupt-parent = <&gpio3>;
        	interrupts = <12 IRQ_TYPE_EDGE_FALLING>;
        };
```

## drivers/iio/position/Kconfig
```kconfig
#
# Optical tracker sensors
#
# When adding new entries keep the list in alphabetical order

menu "Optical tracker sensors"

config PAT9125
	tristate "Optical tracker PAT9125 I2C driver"
	depends on I2C
	select IIO_BUFFER
	help
	  Say yes here to build support for PAT9125 optical tracker
	  sensors.

          To compile this driver as a module, say M here: the module will
          be called pat9125.
endmenu
```
